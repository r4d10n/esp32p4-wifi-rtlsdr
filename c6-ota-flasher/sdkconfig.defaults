## c6-ota-flasher/sdkconfig.defaults
```kconfig
# Target: ESP32-P4
CONFIG_IDF_TARGET="esp32p4"

# PSRAM
CONFIG_SPIRAM=y
CONFIG_SPIRAM_SPEED_80M=y

# Performance
CONFIG_COMPILER_OPTIMIZATION_PERF=y

# FreeRTOS
CONFIG_FREERTOS_HZ=1000

# WiFi via esp_wifi_remote + esp-hosted
CONFIG_ESP_HOST_WIFI_ENABLED=y
CONFIG_ESP_WIFI_CONTROLLER_TARGET="esp32c6"
CONFIG_ESP_WIFI_REMOTE_ENABLED=y
CONFIG_ESP_WIFI_REMOTE_LIBRARY_HOSTED=y
CONFIG_ESP_HOSTED_ENABLED=y
CONFIG_ESP_HOSTED_SPI_HOST_INTERFACE=n
CONFIG_ESP_HOSTED_SDIO_HOST_INTERFACE=y
CONFIG_ESP_SDIO_HOST_INTERFACE=y

# Disable watchdogs for OTA
CONFIG_ESP_INT_WDT=n
CONFIG_ESP_TASK_WDT_EN=n

# Custom partition table (3MB app to fit embedded slave FW)
CONFIG_PARTITION_TABLE_CUSTOM=y
CONFIG_PARTITION_TABLE_CUSTOM_FILENAME="partitions.csv"
CONFIG_ESPTOOLPY_FLASHSIZE_16MB=y

# Log
CONFIG_LOG_DEFAULT_LEVEL_INFO=y
```

## components/dsp/Kconfig
```kconfig
menu "DSP Configuration"

    config DSP_OPTIMIZED
        bool "Enable PIE SIMD optimized DSP kernels"
        default y
        depends on IDF_TARGET_ESP32P4
        help
            Enable hand-optimized PIE assembly kernels for FFT windowing,
            power spectrum, and NCO mixing. Provides 2-8x speedup over
            scalar C implementations on ESP32-P4.

    config FM_DISC_MODE
        int "FM discriminator mode (0=polynomial, 1=fast linear)"
        default 0
        range 0 1
        help
            0 = Polynomial corrected atan2 (<0.3% THD, ~6 cycles/sample)
            1 = Fast linear approximation (~1% THD, ~4 cycles/sample)

    config FM_SCOPE_INTERVAL_MS
        int "Spectrum scope update interval (ms)"
        default 100
        range 50 1000
        help
            How often to send FFT spectrum data over CI-V scope command.
            100ms = 10 FPS. Lower = more CPU but smoother waterfall.

endmenu
```

## components/fm_demod/Kconfig
```kconfig
menu "FM Demodulator Configuration"

    config FM_FIR_TAPS
        int "Audio FIR filter tap count"
        default 63
        range 31 255
        help
            Number of taps for the audio low-pass FIR filter.
            More taps = sharper cutoff but more CPU. Must be odd.
            63 is good for WBFM, 31 for NBFM.

    config FM_FIR_WINDOW
        int "FIR window function (0=Hamming, 1=Blackman, 2=Nuttall)"
        default 2
        range 0 2
        help
            Window function for FIR filter design.
            0 = Hamming (-43 dB sidelobes)
            1 = Blackman (-58 dB sidelobes)
            2 = Nuttall (-93 dB sidelobes, best for FM)


    config FM_NOISE_BLANKER
        bool "Enable noise blanker by default"
        default y
        help
            Enable impulse noise blanker at startup. Can be toggled at runtime.

    config FM_NOISE_BLANKER_THRESHOLD
        int "Default noise blanker threshold (1-10)"
        default 5
        range 1 10
        depends on FM_NOISE_BLANKER
        help
            Blanking threshold multiplier. Higher value = less aggressive blanking.

endmenu
```

## components/fm_stereo/Kconfig
```kconfig
menu "FM Stereo Decoder"

    config FM_STEREO_ENABLE
        bool "Enable FM stereo and RDS decoder"
        default y
        help
            Enable FM stereo MPX decoding (L+R/L-R separation via 19 kHz
            pilot PLL) and RDS data extraction from the 57 kHz subcarrier.

    config FM_STEREO_BLEND_THRESHOLD
        int "Stereo blend threshold (signal strength 0-100)"
        default 30
        range 0 100
        depends on FM_STEREO_ENABLE
        help
            Below this signal strength, output is mono.
            Above threshold+10, output is full stereo.
            0 = always full stereo (no blending).

endmenu
```

## components/ui_hw/Kconfig
```kconfig
menu "Hardware UI Configuration"

    config FM_OLED_ENABLE
        bool "Enable I2C OLED display and rotary encoder"
        default n
        help
            Enable optional SSD1306 128x64 OLED display and rotary
            encoder for hardware-based radio control.

    config FM_OLED_I2C_ADDR
        hex "OLED I2C address"
        default 0x3C
        depends on FM_OLED_ENABLE

    config FM_ENCODER_GPIO_A
        int "Rotary encoder GPIO A"
        default 4
        depends on FM_OLED_ENABLE

    config FM_ENCODER_GPIO_B
        int "Rotary encoder GPIO B"
        default 5
        depends on FM_OLED_ENABLE

    config FM_ENCODER_GPIO_BTN
        int "Rotary encoder button GPIO"
        default 6
        depends on FM_OLED_ENABLE

endmenu
```

## components/usb_audio/Kconfig
```kconfig
menu "USB Audio Configuration"
    config FM_USB_AUDIO_ENABLE
        bool "Enable USB Audio output (UAC 2.0)"
        default n
        help
            Stream demodulated audio to PC as a USB microphone.
            Uses ESP32-P4 USB Controller 1 (FS, GPIO26/27).
            Requires separate USB cable from the RTL-SDR port.
endmenu
```

## components/wifimgr/Kconfig
```kconfig
menu "WiFi Manager Configuration"

    config WIFIMGR_AP_SSID
        string "Default SoftAP SSID"
        default "ESP32P4-SDR-Setup"

    config WIFIMGR_AP_PASSWORD
        string "Default SoftAP password"
        default "sdrsetup"

    config WIFIMGR_AP_CHANNEL
        int "Default SoftAP channel"
        default 1
        range 1 13

    config WIFIMGR_AP_MAX_CONN
        int "SoftAP max connections"
        default 4
        range 1 8

    config WIFIMGR_MAX_NETWORKS
        int "Maximum saved WiFi networks"
        default 8
        range 1 16

    config WIFIMGR_SCAN_RSSI_THRESHOLD
        int "Minimum RSSI threshold (dBm)"
        default -75
        range -90 -30

    config WIFIMGR_SCAN_CYCLES_BEFORE_AP
        int "Scan cycles before AP fallback"
        default 3
        range 1 10

    config WIFIMGR_BUTTON_GPIO
        int "Config mode button GPIO"
        default 0
        help
            GPIO number for config mode button (BOOT=0)

    config WIFIMGR_BUTTON_LONG_PRESS_MS
        int "Button long-press duration (ms)"
        default 3000
        range 1000 10000

    config WIFIMGR_PORTAL_PORT
        int "Config portal HTTP port"
        default 80

    config WIFIMGR_NOTIFY_QUEUE_SIZE
        int "Notification queue depth"
        default 32
        range 8 64

    config WIFIMGR_NOTIFY_MAX_RETRIES
        int "Notification max retries"
        default 3
        range 1 5

    config WIFIMGR_LITTLEFS_PARTITION
        string "LittleFS partition label"
        default "storage"

    config WIFIMGR_ETHERNET_ENABLE
        bool "Enable Ethernet support"
        default n
        help
            Enable RMII Ethernet (IP101/LAN8720 PHY). Available on Olimex ESP32-P4.

endmenu
```

## main/Kconfig.projbuild
```kconfig
menu "FM Radio Configuration"

    config WIFI_SSID
        string "WiFi SSID"
        default "MALARnet"
        help
            SSID of the WiFi network to connect to.

    config WIFI_PASSWORD
        string "WiFi Password"
        default "Peter@1954"
        help
            Password for the WiFi network.

endmenu
```

## sdkconfig.defaults
```kconfig
# Target: ESP32-P4
CONFIG_IDF_TARGET="esp32p4"

# USB Host
CONFIG_USB_HOST_HW_BUFFER_BIAS_BALANCED=y

# WiFi via esp_wifi_remote + esp-hosted (matching reference project)
CONFIG_ESP_WIFI_REMOTE_LIBRARY_HOSTED=y

# ESP-Hosted SDIO transport (Waveshare ESP32-P4-WIFI6)
CONFIG_ESP_HOSTED_SDIO_HOST_INTERFACE=y
CONFIG_ESP_HOSTED_SDIO_CLOCK_FREQ_KHZ=25000
CONFIG_ESP_HOSTED_SDIO_BUS_WIDTH=4

# PSRAM
CONFIG_SPIRAM=y
CONFIG_SPIRAM_SPEED_80M=y

# Ethernet (IP101 PHY on Waveshare ESP32-P4-WIFI6)
CONFIG_ETH_USE_ESP32_EMAC=y
CONFIG_ETH_PHY_INTERFACE_RMII=y

# lwIP — optimize for streaming
CONFIG_LWIP_TCP_SND_BUF_DEFAULT=65534
CONFIG_LWIP_TCP_WND_DEFAULT=65534
CONFIG_LWIP_TCP_RECVMBOX_SIZE=32
CONFIG_LWIP_SO_REUSE=y
CONFIG_LWIP_MAX_SOCKETS=16

# FreeRTOS
CONFIG_FREERTOS_HZ=1000
CONFIG_FREERTOS_UNICORE=n

# HTTP Server — enable WebSocket support
CONFIG_HTTPD_WS_SUPPORT=y

# mDNS
CONFIG_MDNS_MAX_SERVICES=4

# Flash
CONFIG_ESPTOOLPY_FLASHSIZE_16MB=y

# Custom partition table (3MB app)
CONFIG_PARTITION_TABLE_CUSTOM=y
CONFIG_PARTITION_TABLE_CUSTOM_FILENAME="partitions.csv"

# Task watchdog — increase timeout for float DSP on Core 1
CONFIG_ESP_TASK_WDT_TIMEOUT_S=10

# I2S and I2C
CONFIG_SOC_I2S_SUPPORTED=y
CONFIG_I2C_ISR_IRAM_SAFE=y

# OTA
CONFIG_BOOTLOADER_APP_ROLLBACK_ENABLE=y

# Log level
CONFIG_LOG_DEFAULT_LEVEL_INFO=y

# I2S audio output
CONFIG_SOC_I2S_SUPPORTED=y

# I2C for audio codec
CONFIG_I2C_ISR_IRAM_SAFE=y

# OTA support
CONFIG_BOOTLOADER_APP_ROLLBACK_ENABLE=y
```
